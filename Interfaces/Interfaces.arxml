AUTOSAR XML (schema 00046)
package /Interfaces
  sender receiver interface I_Temperature
    data Temperature: implementation-data-type=float32
  client server interface I_StartMotor
    operation StartMotor: possible-error=[I_StartMotor/E_OK, I_StartMotor/E_NOT_OK]
      arg FanSpeed: implementation-data-type=uint8
    error E_OK: error-code=0
    error E_NOT_OK: error-code=1
  client server interface I_StopMotor
    operation StopMotor: possible-error=[I_StopMotor/E_OK, I_StopMotor/E_NOT_OK]
    error E_OK: error-code=0
    error E_NOT_OK: error-code=1
