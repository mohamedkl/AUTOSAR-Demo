AUTOSAR XML (schema 00046)
package /Composition
  composition sw component type CompositionSWC
    component EcuAbstComp: type=TempHBridgeSWC
    component AppSWC: type=ApplicationSWC
    connect EcuAbstComp.PP_Temperature -> AppSWC.RP_Tmeperature
    connect EcuAbstComp.PP_StartMotor -> ApplicationSWC.RP_StartMotor
    connect EcuAbstComp.PP_StopMotor -> ApplicationSWC.RP_StopMotor
